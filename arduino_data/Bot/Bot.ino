

// Pin assignments
const int GND_PIN = 3;   // Simulated GND
const int VCC_PIN = 4;   // Simulated VCC
const int DATA_PIN = 5;  // Data pin for transmission
const int ENABLE_PIN = 6; // Enable pin for transmitter

const int vibSignal[] PROGMEM = {1345,-804,235,-786,193,-798,747,-276,727,-286,709,-302,711,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-796,225};

const int sonSignal[] PROGMEM = {1363, -784, 227, -806, 193, -796, 711, -310, 691, -318, 695, -296, 737,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 195, -1688};

const int nivel1Signal[] PROGMEM = {1333, -822, 199, -814, 193, -796, 711, -310, 723, -286, 697, -296, 739,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 231, -1172};

const int nivel10Signal[] PROGMEM = {1337, -812, 207, -802, 195, -802, 715, -308, 725, -282, 705, -304, 715,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 195, -1056};

const int nivel30Signal[] PROGMEM = {1399, -754, 229, -806, 195, -794, 745, -278, 723, -288, 709, -302, 715,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 195, -1158};

const int nivel60Signal[] PROGMEM = {1373, -778, 245, -772, 229, -772, 713, -308, 725, -284, 707, -304, 717,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 235, -1266};

const int nivel90Signal[] PROGMEM = {1377, -784, 241, -770, 229, -772, 717, -310, 725, -286, 695, -294, 741,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 195, -1184};

// Function to send a given signal array
void sendSignal(const int* signalArray, int arraySize) {
  for (int j = 0; j < 10; j++) {
    for (int i = 0; i < arraySize; i++) {
      int value = pgm_read_word_near(signalArray + i);
      digitalWrite(DATA_PIN, (value > 0) ? HIGH : LOW);
      delayMicroseconds(abs(value));
    }
    digitalWrite(DATA_PIN, LOW); // Ensure the signal is off after sending
  }
}

void setup() {
  pinMode(GND_PIN, OUTPUT);
  pinMode(VCC_PIN, OUTPUT);
  pinMode(ENABLE_PIN, OUTPUT);
  pinMode(DATA_PIN, OUTPUT);

  // Simulate power to the module
  digitalWrite(GND_PIN, LOW);
  digitalWrite(VCC_PIN, HIGH);
  digitalWrite(ENABLE_PIN, HIGH); // Enable the transmitter
  
  // Initialize serial communication
  Serial.begin(9600);
}

void loop() {
  // Check if there is any serial command available
  if (Serial.available() > 0) {
    String command = Serial.readStringUntil('\n');
    command.trim(); // Remove any whitespace/newline characters
    
    if (command.equalsIgnoreCase("vib")) {
      sendSignal(vibSignal, sizeof(vibSignal) / sizeof(vibSignal[0]));
    } else if (command.equalsIgnoreCase("son")) {
      sendSignal(sonSignal, sizeof(sonSignal) / sizeof(sonSignal[0]));
    } else if (command.equalsIgnoreCase("nivel1")) {
      sendSignal(nivel1Signal, sizeof(nivel1Signal) / sizeof(nivel1Signal[0]));
    } else if (command.equalsIgnoreCase("nivel10")) {
      sendSignal(nivel10Signal, sizeof(nivel10Signal) / sizeof(nivel10Signal[0]));
    } else if (command.equalsIgnoreCase("nivel30")) {
      sendSignal(nivel30Signal, sizeof(nivel30Signal) / sizeof(nivel30Signal[0]));
    } else if (command.equalsIgnoreCase("nivel60")) {
      sendSignal(nivel60Signal, sizeof(nivel60Signal) / sizeof(nivel60Signal[0]));
    } else if (command.equalsIgnoreCase("nivel90")) {
      sendSignal(nivel90Signal, sizeof(nivel90Signal) / sizeof(nivel90Signal[0]));
    }
  }
}
